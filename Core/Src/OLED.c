/**
 * @file    oled.c
 * @brief   Driver SSD1306/SH1106 I2C
 */
#include "OLED.h"
#include <string.h>
#include <stdio.h>
#include <stdarg.h>

static I2C_HandleTypeDef *s_hi2c;
static bool    s_ok;
static uint8_t s_buf[OLED_WIDTH * OLED_HEIGHT / 8];
static uint8_t s_x, s_row;

/* Font 5x7 ASCII 32..126 */
static const uint8_t FONT5X7[95][5] = {
    {0x00,0x00,0x00,0x00,0x00},{0x00,0x00,0x5F,0x00,0x00},{0x00,0x07,0x00,0x07,0x00},{0x14,0x7F,0x14,0x7F,0x14},
    {0x24,0x2A,0x7F,0x2A,0x12},{0x23,0x13,0x08,0x64,0x62},{0x36,0x49,0x55,0x22,0x50},{0x00,0x05,0x03,0x00,0x00},
    {0x00,0x1C,0x22,0x41,0x00},{0x00,0x41,0x22,0x1C,0x00},{0x08,0x2A,0x1C,0x2A,0x08},{0x08,0x08,0x3E,0x08,0x08},
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    {0x00,0x00,0x7F,0x00,0x00},{0x00,0x41,0x36,0x08,0x00},{0x08,0x08,0x2A,0x1C,0x08}
};

static bool cmd(uint8_t c)
{
    return HAL_I2C_Mem_Write(s_hi2c, OLED_I2C_ADDR, 0x00, I2C_MEMADD_SIZE_8BIT, &c, 1, 10) == HAL_OK;
}

static const uint8_t *glyph(char c)
{
    if (c < 32 || c > 126) c = '?';
    return FONT5X7[c - 32];
}

bool OLED_Init(I2C_HandleTypeDef *hi2c)
{
    static const uint8_t seq[] = {
        0xAE,             /* display off          */
        0xD5, 0x80,       /* clock divide         */
        0xA8, 0x3F,       /* multiplex 64         */
        0xD3, 0x00,       /* offset 0             */
        0x40,             /* start line 0         */
        0x8D, 0x14,       /* charge pump on       */
        0x20, 0x00,       /* horizontal addressing*/
        0xA1, 0xC8,       /* segment/COM remap    */
        0xDA, 0x12,       /* COM pins             */
        0x81, 0xCF,       /* contrast             */
        0xD9, 0xF1,       /* pre-charge           */
        0xDB, 0x40,       /* VCOMH                */
        0xA4, 0xA6,       /* RAM display, normal  */
        0xAF              /* display on           */
    };
    s_hi2c = hi2c;
    s_ok = false;
    HAL_Delay(50);
    if (HAL_I2C_IsDeviceReady(hi2c, OLED_I2C_ADDR, 3, 20) != HAL_OK) return false;
    for (uint32_t i = 0; i < sizeof(seq); i++)
        if (!cmd(seq[i])) return false;
    s_ok = true;
    OLED_Clear();
    return OLED_Update();
}

bool OLED_IsReady(void) { return s_ok; }

bool OLED_Update(void)
{
    if (!s_ok) return false;
#if OLED_USE_SH1106
    for (uint8_t p = 0; p < 8; p++) {
        cmd((uint8_t)(0xB0 + p)); cmd(0x02); cmd(0x10);
        if (HAL_I2C_Mem_Write(s_hi2c, OLED_I2C_ADDR, 0x40, I2C_MEMADD_SIZE_8BIT,
                              &s_buf[p * OLED_WIDTH], OLED_WIDTH, 50) != HAL_OK) return false;
    }
    return true;
#else
    cmd(0x21); cmd(0); cmd(OLED_WIDTH - 1);
    cmd(0x22); cmd(0); cmd(OLED_ROWS - 1);
    return HAL_I2C_Mem_Write(s_hi2c, OLED_I2C_ADDR, 0x40, I2C_MEMADD_SIZE_8BIT,
                             s_buf, sizeof(s_buf), 200) == HAL_OK;
#endif
}

void OLED_Clear(void) { memset(s_buf, 0, sizeof(s_buf)); s_x = 0; s_row = 0; }

void OLED_ClearRow(uint8_t row)
{
    if (row < OLED_ROWS) memset(&s_buf[row * OLED_WIDTH], 0, OLED_WIDTH);
}

void OLED_SetCursor(uint8_t x_px, uint8_t row) { s_x = x_px; s_row = row; }

void OLED_PutChar(char c)
{
    if (c == '\n') { s_x = 0; s_row++; return; }
    if (s_x + 6 > OLED_WIDTH) { s_x = 0; s_row++; }
    if (s_row >= OLED_ROWS) return;
    const uint8_t *g = glyph(c);
    uint8_t *dst = &s_buf[s_row * OLED_WIDTH + s_x];
    for (uint8_t i = 0; i < 5; i++) dst[i] = g[i];
    dst[5] = 0x00;
    s_x += 6;
}

void OLED_Print(const char *s) { while (*s) OLED_PutChar(*s++); }

static void print_n(const char *s, size_t n) { for (size_t i = 0; i < n && s[i]; i++) OLED_PutChar(s[i]); }

void OLED_PrintLine(uint8_t row, const char *s)
{
    OLED_ClearRow(row);
    OLED_SetCursor(0, row);
    print_n(s, OLED_COLS);
}

void OLED_PrintCenter(uint8_t row, const char *s)
{
    size_t len = strlen(s);
    if (len > OLED_COLS) len = OLED_COLS;
    OLED_ClearRow(row);
    OLED_SetCursor((uint8_t)((OLED_WIDTH - len * 6) / 2), row);
    print_n(s, len);
}

void OLED_Printf(uint8_t row, const char *fmt, ...)
{
    char buf[OLED_COLS + 1];
    va_list ap;
    va_start(ap, fmt);
    vsnprintf(buf, sizeof(buf), fmt, ap);
    va_end(ap);
    OLED_PrintLine(row, buf);
}

static void put_large(uint8_t x, uint8_t row, char c)
{
    const uint8_t *g = glyph(c);
    for (uint8_t col = 0; col < 5; col++) {
        uint16_t w = 0;                               /* nhan doi chieu cao 8 -> 16 bit */
        for (uint8_t b = 0; b < 8; b++)
            if (g[col] & (1u << b)) w |= (uint16_t)(3u << (b * 2));
        for (uint8_t dx = 0; dx < 2; dx++) {          /* nhan doi chieu ngang */
            uint16_t xx = (uint16_t)(x + col * 2 + dx);
            if (xx >= OLED_WIDTH) return;
            s_buf[row * OLED_WIDTH + xx] = (uint8_t)(w & 0xFF);
            if (row + 1 < OLED_ROWS) s_buf[(row + 1) * OLED_WIDTH + xx] = (uint8_t)(w >> 8);
        }
    }
}

void OLED_PrintLargeCenter(uint8_t row, const char *s)
{
    size_t len = strlen(s);
    if (len > 10) len = 10;
    OLED_ClearRow(row);
    OLED_ClearRow((uint8_t)(row + 1));
    uint8_t x = (uint8_t)((OLED_WIDTH - len * 12) / 2);
    for (size_t i = 0; i < len; i++, x += 12) put_large(x, row, s[i]);
}

void OLED_InvertRow(uint8_t row)
{
    if (row >= OLED_ROWS) return;
    for (uint8_t i = 0; i < OLED_WIDTH; i++) s_buf[row * OLED_WIDTH + i] ^= 0xFF;
}

void OLED_DrawPixel(uint8_t x, uint8_t y, bool on)
{
    if (x >= OLED_WIDTH || y >= OLED_HEIGHT) return;
    if (on) s_buf[x + (y / 8) * OLED_WIDTH] |=  (uint8_t)(1u << (y % 8));
    else    s_buf[x + (y / 8) * OLED_WIDTH] &= (uint8_t)~(1u << (y % 8));
}

void OLED_SetContrast(uint8_t value) { if (s_ok) { cmd(0x81); cmd(value); } }
void OLED_DisplayOn(bool on)         { if (s_ok) cmd(on ? 0xAF : 0xAE); }
